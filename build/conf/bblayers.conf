## build/conf/bblayers.conf
```bitbake
# LAYER_CONF_VERSION is increased each time build/conf/bblayers.conf
# changes incompatibly
LCONF_VERSION = "6"

BBPATH = "${TOPDIR}"
BBFILES ?= ""

BBLAYERS ?= " \
  /home/posborne/Projects/rust-playground/rustbone/poky/meta \
  /home/posborne/Projects/rust-playground/rustbone/poky/meta-yocto \
  /home/posborne/Projects/rust-playground/rustbone/poky/meta-yocto-bsp \
  "
BBLAYERS_NON_REMOVABLE ?= " \
  /home/posborne/Projects/rust-playground/rustbone/poky/meta \
  /home/posborne/Projects/rust-playground/rustbone/poky/meta-yocto \
  "
```

## build/conf/local.conf
```bitbake
MACHINE ?= "beaglebone"
DL_DIR ?= "/home/posborne/.yocto/downloads"
SSTATE_DIR ?= "/home/posborne/.yocto/sstate-cache"
#TMPDIR = "${TOPDIR}/tmp"
DISTRO ?= "poky"
PACKAGE_CLASSES ?= "package_rpm"
#SDKMACHINE ?= "i686"
EXTRA_IMAGE_FEATURES = "debug-tweaks tools-debug eclipse-debug"
USER_CLASSES ?= "buildstats image-mklibs image-prelink"

PREFERRED_PROVIDER_virtual/kernel = "linux-stable"
PREFERRED_VERSION_linux-stable = "4.2%"

#TEST_IMAGE = "1"
#OE_TERMINAL = "auto"
PATCHRESOLVE = "noop"
BB_DISKMON_DIRS = "\
    STOPTASKS,${TMPDIR},1G,100K \
    STOPTASKS,${DL_DIR},1G,100K \
    STOPTASKS,${SSTATE_DIR},1G,100K \
    ABORT,${TMPDIR},100M,1K \
    ABORT,${DL_DIR},100M,1K \
    ABORT,${SSTATE_DIR},100M,1K" 
#SSTATE_MIRRORS ?= "\
#file://.* http://someserver.tld/share/sstate/PATH;downloadfilename=PATH \n \
#file://.* file:///some/local/dir/sstate/PATH"
PACKAGECONFIG_append_pn-qemu-native = " sdl"
PACKAGECONFIG_append_pn-nativesdk-qemu = " sdl"
ASSUME_PROVIDED += "libsdl-native"
CONF_VERSION = "1"
```

## meta-rustbone/conf/layer.conf
```bitbake
# We have a conf and classes directory, append to BBPATH
BBPATH .= ":${LAYERDIR}"

# We have a recipes directory, add to BBFILES
BBFILES += "${LAYERDIR}/recipes*/*/*.bb ${LAYERDIR}/recipes*/*/*.bbappend"

BBFILE_COLLECTIONS += "rustbone"
BBFILE_PATTERN_rustbone := "^${LAYERDIR}/"
BBFILE_PRIORITY_rustbone = "8"

# This should only be incremented on significant changes that will
# cause compatability issues with other layers
LAYERVERSION_rustbone = "1"
LAYERDEPENDS_rustbone = "core rust-layer"
```
